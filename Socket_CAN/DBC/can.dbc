VERSION ""

BU_: ECU Receiver

//1+がリトルエンディアン0+がビッグエンディアン
//0+にすると警告が出る
BO_ 256 SPEED: 2 ECU
 SG_ VehicleSpeed : 0|16@1+ (0.1,0) [0|250] "km/h" Receiver

BO_ 257 OIL_TEMP: 1 ECU
 SG_ OilTemperature : 0|8@1+ (1,0) [-40|200] "degC" Receiver

BO_ 258 WATER_TEMP: 1 ECU
 SG_ WaterTemperature : 0|8@1+ (1,0) [-40|200] "degC" Receiver

BO_ 259 RPM: 2 ECU
 SG_ EngineRPM : 0|16@1+ (1,0) [0|8000] "rpm" Receiver

//BO_ 256 VEHICLE_STATUS: 8 ECU

//SG_ VehicleSpeed   : 0|16@1+ (0.1,0) [0|250] "km/h" Receiver
//SG_ OilTemperature : 16|8@1+ (1,0) [-40|200] "degC" Receiver
//SG_ WaterTemperature : 24|8@1+ (1,0) [-40|200] "degC" Receiver
//SG_ EngineRPM : 32|16@1+ (1,0) [0|8000] "rpm" Receiver
